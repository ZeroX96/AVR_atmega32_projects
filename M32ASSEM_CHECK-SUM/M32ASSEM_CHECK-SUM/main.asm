;
; M32ASSEM_CHECK-SUM.asm
;
; Created: 17/03/2018 10:06:48
; Author : Mahmoud SAAD
;
.INCLUDE "M32DEF.INC"
.ORG 0X00
;INIT THE STACK
LDI R17,HIGH(RAMEND)
OUT SPH,R17
LDI R17,LOW(RAMEND)
OUT SPL,R17
;.DEFINES
.EQU OPTIONS_SIZE=0X05 ;THE COUNTER
.EQU RAM_OPTIONS=0X100

										;************************************************************
MAIN :
;LOAD DATA FROM THE EEPROM TO THE FLASH
CALL EEPROM_2_RAM         
;TEST CHECKSUM
CALL TST_CHKSUM
;SET THE STATUS AS THE OUTPUT OF THE CHECKING
TST R25
;SO IF NO ERRORS Z WILL BE SET TO ONE
;JUMP TO CONT_1
BREQ CONT_1
;ELSE,Z!= THEN RE-INIT OPTIONS
CALL REINIT_OPTIONS
CONT_1 :
;CAL CHEKSUM
CALL CAL_CHKSUM
;STORE THE DATA BACK TO THE EEPROM
CALL RAM_2_EEPROM
RJMP MAIN
										;************************************************************
;WRITE TO THE EEBROM ADD
WRITE_2_EEPROM :
			SBIC EECR,EEWE
			RJMP WRITE_2_EEPROM
			OUT EEARH,XH
			OUT EEARL,XL
			OUT EEDR,R16
			SBI EECR,EEMWE
			SBI EECR,EEWE
			RET
										;************************************************************
READ_FROM_EEPROM :
			SBIC EECR,EEWE
			RJMP READ_FROM_EEPROM
			OUT EEARH,XH
			OUT EEARL,XL
			SBI EECR,EERE
			IN R22,EEDR
			RET
										;************************************************************
RAM_2_EEPROM :;POINT TO EEPROM BY X
			LDI XH,HIGH(EEPROM_OPTIONS)
			LDI XL,LOW(EEPROM_OPTIONS)
			;POINT TO THE RAM BY Y
			LDI YH,HIGH(RAM_OPTIONS)
			LDI YL,LOW(RAM_OPTIONS)
			LDI R21,OPTIONS_SIZE+1
LOOP_GETTING_R_DATA :
			LD R16,Y+
			CALL WRITE_2_EEPROM
			INC XL
			BRNE NO_X_FLOW
			INC XH
NO_X_R_FLOW :DEC R21
			BRNE LOOP_GETTING_DATA
			RET
										;************************************************************
EEPROM_2_RAM :						
			;POINT TO EEPROM BY X
			LDI XH,HIGH(EEPROM_OPTIONS)
			LDI XL,LOW(EEPROM_OPTIONS)
			;POINT TO THE RAM BY Y
			LDI YH,HIGH(RAM_OPTIONS)
			LDI YL,LOW(RAM_OPTIONS)
			LDI R21,OPTIONS_SIZE+1
LOOP_GETTING_DATA :
			RCALL READ_FROM_EEPROM
			ST Y+,R22
			INC XL
			BRNE NO_X_FLOW
			INC XH
NO_X_FLOW : DEC R21
			BRNE LOOP_GETTING_DATA
			RET

										;************************************************************
TST_CHKSUM :
			LDI YH,HIGH(RAM_OPTIONS)
			LDI YL,LOW(RAM_OPTIONS)
			LDI R21,OPTIONS_SIZE+1 ;AS CHECK SUM WILL BE ADDED TO TEST BLOCK'S CORRECTNESS  
			LDI R25,0X00
CHK_ALL :   LD R24,Y
			ADD R25,R24  ;MUST CLEAR R25 FIRST 
			INC YL
			BRNE NO_Y_FLOW
			INC YH
NO_Y_FLOW :	DEC R21
			BRNE CHK_ALL
			;NEG R25	TESTING THE CHECKSUM NOT GETTING IT
			;HAVING THE COUNTER =SIZE + 1,WILL ADD THE CHEKSUM TO THE BLOCK SUMMETION 
			RET  ;WILL REPEAT THIS AGAIN OR WAT,WILL SEE LATER


										;************************************************************
REINIT_OPTIONS :
			;POINT TO PROGRAM MEMORY BY Z
			LDI ZH,HIGH(FLASH_OPTIONS)
			LDI ZL, LOW(FLASH_OPTIONS)
			;POINT TO THE RAM BY Y
			LDI YH,HIGH(RAM_OPTIONS)
			LDI YL,LOW(RAM_OPTIONS)
			LDI R21,OPTIONS_SIZE+1
LOOP_GETTING_F_DATA :
			LPM R22,Z
			ST Y+,R22
			INC ZL
			BRNE NO_XF_FLOW
			INC ZH
NO_XF_FLOW :DEC R21
			BRNE LOOP_GETTING_F_DATA
			RET
										;************************************************************
CAL_CHKSUM :
			LDI YH,HIGH(RAM_OPTIONS)
			LDI YL,LOW(RAM_OPTIONS)
			LDI R21,OPTIONS_SIZE ;AS CHECK SUM WILL BE ADDED TO TEST BLOCK'S CORRECTNESS  
			LDI R25,0X00
CAL_C_ALL : LD R24,Y
			ADD R25,R24  ;MUST CLEAR R25 FIRST 
			INC YL
			BRNE NO_Y_C_FLOW
			INC YH
NO_Y_C_FLOW:DEC R21
			BRNE CAL_C_ALL
			NEG R25	;GETTING THE CHECKSUM
			;HAVING THE COUNTER =SIZE + 1,WILL ADD THE CHEKSUM TO THE BLOCK SUMMETION 
			ST Y,R25
			RET  ;WILL REPEAT THIS AGAIN OR WAT,WILL SEE LATER
			
										;************************************************************
FLASH_OPTIONS :
				.DB		0X50,0X60,0X70,0X80

;STORE DATA IN THE EEPROM AS A CODE (I.E .DB)
.ESEG
.ORG 0X00
EEPROM_OPTIONS :
				.DB		0X50,0X60,0X70,0X80,0X90
