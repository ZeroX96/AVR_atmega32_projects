;
; M32ASSEM_PORTA+TOGGLING.asm
;
; Created: 15-Oct-17 03:43:22 PM
; Author : Mahmoud
;


; Replace with your application code
.INCLUDE "M32DEF.INC"
.ORG 0

LDI R16,HIGH (RAMEND)
OUT SPH,R16
LDI R17,LOW (RAMEND)
OUT SPL,R16

MAIN:
	LDI R16,0XFF
	OUT DDRA,R16
	LDI R16,0X00
LOOP :
	OUT	PORTA,R16
	INC R16
	call DELAY
	RJMP LOOP
	
	
	DELAY : LDI R17,100
			
	AGAIN :		LDI R18,100
	AGAINPLUS :
			NOP
			NOP
			NOP 
			DEC R18
			BRNE AGAINPLUS
			DEC R17
			BRNE AGAIN
			RET 
			/*
;USING SBI AND CBI INSTRUCTIONS
.INCLUDE "M32DEF.INC"
.ORG 0

LDI R16,HIGH (RAMEND)
OUT SPH,R16
LDI R17,LOW (RAMEND)
OUT SPL,R16

MAIN:
	LDI R16,0XFF
	OUT DDRA,R16
	LDI R16,0X00
LOOP : OUT PORTA,R16
	SBI PORTA,0
	call DELAY
	CBI PORTA,0
	SBI PORTA,1
	call DELAY
	CBI PORTA,1
	SBI PORTA,2
	call DELAY
	CBI PORTA,2
	SBI PORTA,3
	call DELAY
	CBI PORTA,3
	SBI PORTA,4
	call DELAY
	CBI PORTA,4
	SBI PORTA,5
	call DELAY
	CBI PORTA,5
	SBI PORTA,6
	call DELAY
	CBI PORTA,6
	SBI PORTA,7
	call DELAY
	CBI PORTA,7
	RJMP LOOP
	
	
	DELAY : LDI R17,200
			
	AGAIN :		LDI R18,200
	AGAINPLUS :
			NOP
			NOP
			NOP 
			DEC R18
			BRNE AGAINPLUS
			DEC R17
			BRNE AGAIN
			RET 
			*/
